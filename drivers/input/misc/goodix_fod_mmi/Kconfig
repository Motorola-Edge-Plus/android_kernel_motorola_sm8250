## drivers/input/misc/vl53L1/Kconfig
```kconfig
config INPUT_MISC_STMVL53L1
	tristate "STMVL53L1"

config INPUT_MISC_TOF_USE_VL53L3
	bool "TOF use VL53L1"

config INPUT_MISC_PMIC_WL2864C
	bool "PMIC WL2864C"
```

## drivers/input/touchscreen/goodix_gtx8_v1430_mmi/Kconfig
```kconfig
config INPUT_TOUCHSCREEN_GOODIX_GTX8_V1430_MMI
	tristate "Goodix GTX8 V1430 MMI"
```

## drivers/input/touchscreen/touchscreen_mmi/Kconfig
```kconfig
config DRM_DYNAMIC_REFRESH_RATE
	bool "DRM Dynamic Refresh Rate"

config TOUCHCLASS_MMI_DEBUG_INFO
	bool "MMI Debug Info"

config TOUCHCLASS_MMI_GESTURE_POISON_EVENT
	bool "MMI Gesture Poison Event"

config DRM_PANEL_NOTIFICATIONS
	bool "DRM Panel Notifications"

config INPUT_TOUCHSCREEN_MMI_I2C
	bool "Touchscreen MMI I2C"

config INPUT_TOUCHSCREEN_MMI
	tristate "Touchscreen MMI"
```

## drivers/misc/sx933x/Kconfig
```kconfig
config SX933X
	tristate "SX933X"

config CAPSENSE_USB_CAL
	bool "USB calibration"

config CAPSENSE_ATTACH_CAL
	bool "Attach calibration"

config CAPSENSE_FLIP_CAL
	bool "Flip calibration"

config CAPSENSE_HEADSET_STATE
	bool "Headset state"
```
